## poky/build/conf/bblayers.conf
```bitbake
# POKY_BBLAYERS_CONF_VERSION is increased each time build/conf/bblayers.conf
# changes incompatibly
POKY_BBLAYERS_CONF_VERSION = "2"

BBPATH = "${TOPDIR}"
BBFILES ?= ""

BBLAYERS ?= " \
  /home/ubuntu/Yocto/poky/meta \
  /home/ubuntu/Yocto/poky/meta-poky \
  /home/ubuntu/Yocto/poky/meta-yocto-bsp \
  "
```
